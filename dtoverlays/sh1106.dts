/dts-v1/;
/plugin/;

/ {
    compatible = "brcm,bcm2835";

    fragment@0 {
        target = <&spidev0>;
        __overlay__ {
            status = "disabled"; // Disable spidev@0 to avoid conflicts
        };
    };

    fragment@1 {
        target = <&spi0>;
        __overlay__ {
            status = "okay"; // Enable spi0 bus
            #address-cells = <1>;
            #size-cells = <0>;

            sh1106: sh1106@0 {
                compatible = "sino,sh1106";
                reg = <0x0>; // Chip select 0
                spi-max-frequency = <10000000>; // 10 MHz
                dc-gpios = <&gpio 25 0>; // GPIO25 for Data/Command
                status = "okay";
            };
        };
    };

    __fixups__ {
        spidev0 = "/soc/spi@7e204000/spidev@0:status";
        spi0 = "/soc/spi@7e204000:status";
    };
};
